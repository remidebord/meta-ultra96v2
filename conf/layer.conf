## conf/layer.conf
```bitbake
# We have a conf and classes directory, add to BBPATH
BBPATH .= ":${LAYERDIR}"

# We have recipes-* directories, add to BBFILES
BBFILES += "${LAYERDIR}/recipes-*/*/*.bb \
            ${LAYERDIR}/recipes-*/*/*.bbappend"

BBFILE_COLLECTIONS += "meta-ultra96v2"
BBFILE_PATTERN_meta-ultra96v2 = "^${LAYERDIR}/"
BBFILE_PRIORITY_meta-ultra96v2 = "6"

LAYERDEPENDS_meta-ultra96v2 = "core"
LAYERSERIES_COMPAT_meta-ultra96v2 = "kirkstone langdale"
```

## conf/machine/ultra96v2.conf
```bitbake
#@TYPE: Machine
#@NAME: ultra96v2
#@DESCRIPTION: Machine support for Ultra96v2.
#

MACHINEOVERRIDES = "ultra96:ultra96-zynqmp:u96v2-sbc:u96v2-sbc-base:${MACHINE}"
HDF_MACHINE = "u96v2-sbc-base"

require conf/machine/include/soc-zynqmp.inc
require conf/machine/include/machine-xilinx-default.inc

MACHINE_FEATURES += "rtc ext2 ext3 vfat usbhost usbgadget wifi bluetooth"

UBOOT_MACHINE = "xilinx_zynqmp_virt_defconfig"
# prevent U-Boot from deploying the boot.bin
SPL_BINARY = ""

YAML_SERIAL_CONSOLE_STDIN:pn-pmu-firmware ?= "psu_uart_1"
YAML_SERIAL_CONSOLE_STDOUT:pn-pmu-firmware ?= "psu_uart_1"

YAML_SERIAL_CONSOLE_STDIN:pn-fsbl-firmware ?= "psu_uart_1"
YAML_SERIAL_CONSOLE_STDOUT:pn-fsbl-firmware ?= "psu_uart_1"

SERIAL_CONSOLES ?= "115200;ttyPS0"

PMU_FIRMWARE_IMAGE_NAME ?= "pmu-firmware-zynqmp-pmu"
PMU_FIRMWARE_DEPLOY_DIR ?= "${TOPDIR}/pmutmp/deploy/images/zynqmp-pmu"

EXTRA_IMAGEDEPENDS += " \
			arm-trusted-firmware \
			virtual/bootloader \
			u-boot-xlnx-scr \
			virtual/fsbl \
			virtual/pmu-firmware \
			virtual/boot-bin \
			"

MACHINE_ESSENTIAL_EXTRA_RRECOMMENDS += "linux-firmware-wl18xx"

EXTRA_IMAGEDEPENDS:remove = "qemu-devicetrees"

DISTRO_FEATURES:append = " bluez5 dbus"

# Hardware design
HDF_BASE = "file://" 
HDF_PATH = "u96v2_sbc_base.xsa"
```
